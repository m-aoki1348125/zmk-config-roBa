## config/custom/Kconfig
```kconfig
# Copyright (c) 2024 roBa Project
# SPDX-License-Identifier: MIT

config ZMK_INPUT_PROCESSOR_VELOCITY_SCALER
    bool "Velocity-based input processor"
    depends on ZMK_INPUT
    default y
    help
      Enable velocity-based input processor for dynamic mouse acceleration.
      This processor calculates movement velocity and applies scaling based
      on configurable acceleration curves.
```

## config/custom/dts/bindings/input_processors/zmk,input-processor-velocity-scaler.yaml
```yaml
# Copyright (c) 2024 roBa Project
# SPDX-License-Identifier: MIT

description: ZMK velocity-based input processor for dynamic mouse acceleration

compatible: "zmk,input-processor-velocity-scaler"

include: ip_two_param.yaml

properties:
  type:
    type: int
    required: true
    description: Input event type to process

  codes:
    type: array
    required: true
    description: Input event codes to process

  min-scale-factor:
    type: int
    default: 50
    description: Minimum scaling factor in percent (100 = 1.0x)

  max-scale-factor:
    type: int
    default: 300
    description: Maximum scaling factor in percent (100 = 1.0x)

  velocity-threshold:
    type: int
    default: 500
    description: Velocity threshold in pixels per second for full acceleration

  acceleration-power:
    type: int
    default: 150
    description: Acceleration curve power in percent (100 = linear, >100 = more aggressive)

  track-remainders:
    type: boolean
    default: true
    description: Track fractional remainders for smooth scaling
```

## config/west.yml
```yaml
manifest:
  remotes:
    - name: zmkfirmware
      url-base: https://github.com/zmkfirmware
    - name: kumamuk-git
      url-base: https://github.com/kumamuk-git
  projects:
    - name: zmk
      remote: zmkfirmware
      revision: main
      import: app/west.yml
    - name: zmk-pmw3610-driver
      remote: kumamuk-git
      revision: main
    # Mouse gesture disabled for stable auto mouse layer
    # - name: zmk-mouse-gesture
    #   remote: kot149
    #   revision: v1
  self:
    path: config
```
