#include "roBa.dtsi"

&default_transform {
    col-offset = <6>;
};

&kscan0 {
        col-gpios
            = <&xiao_d 10 GPIO_ACTIVE_HIGH>
            , <&xiao_d 9 GPIO_ACTIVE_HIGH> 
            , <&xiao_d 8 GPIO_ACTIVE_HIGH> 
            , <&xiao_d 7 GPIO_ACTIVE_HIGH> 
            , <&gpio0 10 GPIO_ACTIVE_HIGH>
            ;
};

/ {
    // マウスジェスチャー機能のみ（PMW3610センサーなし）
    mouse_gesture_processor {
        compatible = "zmk,input-processor-mouse-gesture";
        #input-processor-cells = <0>;
        stroke-size = <300>;
        movement-threshold = <10>;
        enable-8way;
    };
};